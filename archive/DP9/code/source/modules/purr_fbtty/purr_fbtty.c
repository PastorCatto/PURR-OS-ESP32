// purr_fbtty.c — see purr_fbtty.h for the full picture.
#include <string.h>
#include "purr_fbtty.h"
#include "purr_kernel.h"
#include "catcall_display.h"
#include "catcall_input.h"
#include "freertos/FreeRTOS.h"
#include "freertos/task.h"

#define FONT_W 6
#define FONT_H 8
#define FG_COLOR 0xFFFFu   // white text
#define BG_COLOR 0x0000u   // black background

// Font table copied from boot_splash.c, not shared — same reasoning that
// file's own comment already gives (oled_ui_module.c copies its own too):
// this module must stay independently linkable regardless of which other
// text-drawing modules a given build does or doesn't include.
static const uint8_t s_font6x8[][6] = {
    {0x00,0x00,0x00,0x00,0x00,0x00}, {0x00,0x00,0x5F,0x00,0x00,0x00},
    {0x00,0x07,0x00,0x07,0x00,0x00}, {0x14,0x7F,0x14,0x7F,0x14,0x00},
    {0x24,0x2A,0x7F,0x2A,0x12,0x00}, {0x23,0x13,0x08,0x64,0x62,0x00},
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    {0x08,0x04,0x08,0x10,0x08,0x00},
};

// Grid caps — generous for any panel this codebase targets today (largest
// is Tab5's 1280x720, which even at scale 1 is 213x90; MAX_COLS/ROWS below
// only need to cover the SMALLEST panels, since larger ones just leave the
// grid's tail unused — actual cols/rows are computed from the real panel
// size at init() and clamped to these).
#define FBTTY_MAX_COLS 96
#define FBTTY_MAX_ROWS 64

static const catcall_display_t *s_disp = NULL;
static int      s_cols = 0, s_rows = 0;
static int      s_cur_row = 0, s_cur_col = 0;
static char     s_grid[FBTTY_MAX_ROWS][FBTTY_MAX_COLS];

// ── Glyph drawing — same shape as boot_splash.c's draw_char/draw_str ────────

static void draw_char_at(int row, int col, char c)
{
    if (c < 0x20 || c > 0x7E) c = ' ';
    const uint8_t *glyph = s_font6x8[(unsigned char)c - 0x20];
    uint16_t buf[FONT_W * FONT_H];
    for (int cx = 0; cx < FONT_W; cx++) {
        uint8_t bits = glyph[cx];
        for (int cy = 0; cy < FONT_H; cy++) {
            buf[cy * FONT_W + cx] = (bits & (1 << cy)) ? FG_COLOR : BG_COLOR;
        }
    }
    s_disp->push_pixels(col * FONT_W, row * FONT_H, FONT_W, FONT_H, buf);
}

// Full redraw from s_grid — only called on scroll, not per-keystroke (see
// this file's own top comment on why: a full push_pixels per glyph is
// cheap one at a time, but doing it for every cell on every scroll would
// visibly lag once the screen fills, so the fast per-character path below
// is used whenever nothing actually needs to move).
static void redraw_all(void)
{
    s_disp->fill_rect(0, 0, s_cols * FONT_W, s_rows * FONT_H, BG_COLOR);
    for (int r = 0; r < s_rows; r++) {
        for (int c = 0; c < s_cols; c++) {
            char ch = s_grid[r][c];
            if (ch != ' ' && ch != '\0') draw_char_at(r, c, ch);
        }
    }
}

static void scroll_up(void)
{
    memmove(s_grid[0], s_grid[1], (size_t)(s_rows - 1) * FBTTY_MAX_COLS);
    memset(s_grid[s_rows - 1], 0, FBTTY_MAX_COLS);
    redraw_all();
}

static void newline(void)
{
    s_cur_col = 0;
    s_cur_row++;
    if (s_cur_row >= s_rows) {
        s_cur_row = s_rows - 1;
        scroll_up();
    }
}

static void put_char(char c)
{
    if (c == '\n') { newline(); return; }
    if (c == '\r') { s_cur_col = 0; return; }
    if (c == '\b') { if (s_cur_col > 0) s_cur_col--; return; }
    if (c < 0x20 || c > 0x7E) return;   // drop other control bytes silently

    s_grid[s_cur_row][s_cur_col] = c;
    draw_char_at(s_cur_row, s_cur_col, c);
    s_cur_col++;
    if (s_cur_col >= s_cols) newline();
}

// ── purr_console_io_t binding ────────────────────────────────────────────

static void fbtty_write(const void *data, size_t len)
{
    const char *p = (const char *)data;
    for (size_t i = 0; i < len; i++) put_char(p[i]);
}

static void fbtty_flush(void)
{
    // push_pixels() is synchronous (see catcall_display.h) — nothing to
    // wait on beyond what draw_char_at() already did inline.
}

static int fbtty_read_byte(uint32_t timeout_ms)
{
    int count = purr_kernel_input_count();
    if (count <= 0) {
        // No input device registered at all (yet, or ever, on this
        // device) — honor the timeout contract rather than busy-spinning.
        vTaskDelay(pdMS_TO_TICKS(timeout_ms));
        return -1;
    }

    // Poll EVERY registered input, not just purr_kernel_input()'s "first
    // registered (legacy)" one — T-Deck Plus registers trackball before
    // bbq20 (kernel_tdp_boot.c's own Phase 0 order), so purr_kernel_
    // input() alone would silently hand this console the trackball's
    // pointer-only catcall, which never produces a KEY_DOWN event at
    // all. Confirmed live: exactly this made every keypress a no-op
    // before this loop existed — the console drew "password:" correctly
    // (display side works) but nothing ever arrived from the keyboard.
    // Harmless to poll a pointer-only device too — it just never yields
    // INPUT_EVENT_KEY_DOWN, so mixing it in can't produce a false keypress.
    uint32_t waited_ms = 0;
    const uint32_t step_ms = 15;   // matches bbq20's own ~20ms poll cadence closely enough
    for (;;) {
        for (int i = 0; i < count; i++) {
            const catcall_input_t *input = purr_kernel_input_at(i);
            if (!input) continue;
            input_event_t ev;
            while (input->poll_event(&ev)) {
                if (ev.type == INPUT_EVENT_KEY_DOWN && ev.keycode > 0 && ev.keycode <= 0xFF) {
                    return (int)ev.keycode;
                }
                // KEY_UP / POINTER / anything else this console doesn't use — skip.
            }
        }
        if (waited_ms >= timeout_ms) return -1;
        vTaskDelay(pdMS_TO_TICKS(step_ms));
        waited_ms += step_ms;
    }
}

const purr_console_io_t purr_fbtty_io = {
    .read_byte = fbtty_read_byte,
    .write     = fbtty_write,
    .flush     = fbtty_flush,
};

bool purr_fbtty_init(void)
{
    s_disp = purr_kernel_display();
    if (!s_disp) return false;

    display_info_t info;
    s_disp->get_info(&info);

    s_cols = info.width  / FONT_W;
    s_rows = info.height / FONT_H;
    if (s_cols > FBTTY_MAX_COLS) s_cols = FBTTY_MAX_COLS;
    if (s_rows > FBTTY_MAX_ROWS) s_rows = FBTTY_MAX_ROWS;
    if (s_cols < 1 || s_rows < 1) return false;

    memset(s_grid, 0, sizeof(s_grid));
    s_cur_row = 0;
    s_cur_col = 0;
    s_disp->fill_rect(0, 0, info.width, info.height, BG_COLOR);
    return true;
}
