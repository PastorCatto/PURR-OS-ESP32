// boot_splash.c — raw-framebuffer boot splash
//
// Drawn directly via catcall_display_t (push_pixels/fill_rect), the same
// layer oled_ui uses for its own boot message — deliberately no LVGL, no
// MiniWin dependency, so it works before either UI backend has even
// started, and regardless of which one a given device ends up using.
// Called directly from each device's own boot sequence (e.g.
// kernel_tdp_boot.c), right after the display driver registers — not
// through the P2/P3 static module loader, which only runs much later.
//
// Classic DOS-style "Starting Windows..." look: black background, white
// text, a segmented progress bar. boot_splash_advance() is called once per
// boot phase (see kernel_tdp_boot.c's own "=== phase N ===" markers) —
// there's no hard timeout here; in practice the real UI backend's own
// first full-screen paint (Cupcake or MiniWin, both of which redraw the
// whole display on their first frame) naturally supersedes this before it
// would ever look stale.

#include <string.h>
#include "boot_splash.h"
#include "purr_kernel.h"
#include "catcall_display.h"

#define FONT_W 6
#define FONT_H 8
#define COL_BLACK 0x0000u
#define COL_WHITE 0xFFFFu

// Minimal 6x8 font — printable ASCII 0x20-0x7E, one column per byte, rows
// packed MSB first. Same table shape as oled_ui_module.c's own — copied
// rather than shared, since the two modules must stay independently
// linkable (a device might have one, both, or neither compiled in).
static const uint8_t s_font6x8[][6] = {
    {0x00,0x00,0x00,0x00,0x00,0x00}, // 0x20 space
    {0x00,0x00,0x5F,0x00,0x00,0x00}, // !
    {0x00,0x07,0x00,0x07,0x00,0x00}, // "
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    {0x08,0x04,0x08,0x10,0x08,0x00}, // ~
};

static const catcall_display_t *s_disp = NULL;
static int      s_step  = 0;
static int      s_steps = BOOT_SPLASH_STEPS;
static int16_t  s_bar_x, s_bar_y, s_bar_w, s_bar_h;
static int16_t  s_status_y = 0;
static int16_t  s_scr_w    = 320;

// Renders one glyph, scaled by `scale`, via a single push_pixels() call —
// same "build a small local buffer, push once" shape as oled_ui, just
// RGB565 (colour panel) instead of that module's 1bpp OLED.
static void draw_char(int x, int y, char c, uint16_t fg, uint16_t bg, int scale)
{
    if (c < 0x20 || c > 0x7E) c = '?';
    const uint8_t *glyph = s_font6x8[c - 0x20];
    uint16_t buf[FONT_W * 4 * FONT_H * 4];   // headroom for scale up to 4
    int bw = FONT_W * scale, bh = FONT_H * scale;

    for (int col = 0; col < FONT_W; col++) {
        uint8_t bits = glyph[col];
        for (int row = 0; row < FONT_H; row++) {
            uint16_t px = (bits & (1 << row)) ? fg : bg;
            for (int sy = 0; sy < scale; sy++) {
                for (int sx = 0; sx < scale; sx++) {
                    buf[(row * scale + sy) * bw + (col * scale + sx)] = px;
                }
            }
        }
    }
    s_disp->push_pixels(x, y, bw, bh, buf);
}

static void draw_str(int x, int y, const char *str, uint16_t fg, uint16_t bg, int scale)
{
    while (*str) {
        draw_char(x, y, *str++, fg, bg, scale);
        x += FONT_W * scale;
    }
}

static int str_width(const char *str, int scale) { return (int)strlen(str) * FONT_W * scale; }

void purr_splash_show(const char *title, int steps)
{
    s_disp = purr_kernel_display();
    if (!s_disp) return;
    if (!title) title = "PURR OS";
    s_steps = steps > 0 ? steps : 1;

    display_info_t info;
    if (s_disp->get_info) s_disp->get_info(&info);
    else { info.width = 320; info.height = 240; }
    s_scr_w = (int16_t)info.width;

    if (s_disp->fill_rect) s_disp->fill_rect(0, 0, info.width, info.height, COL_BLACK);

    int scale = info.width >= 240 ? 2 : 1;
    draw_str((info.width - str_width(title, scale)) / 2, (int)info.height * 4 / 10,
             title, COL_WHITE, COL_BLACK, scale);

    // Progress bar: white outline (two nested fill_rects) with a black
    // interior, filled left-to-right by boot_splash_advance().
    s_bar_w = (int16_t)(info.width * 6 / 10);
    s_bar_h = 10;
    s_bar_x = (int16_t)((info.width - s_bar_w) / 2);
    s_bar_y = (int16_t)((int)info.height * 4 / 10 + FONT_H * scale + 20);
    if (s_disp->fill_rect) {
        s_disp->fill_rect(s_bar_x, s_bar_y, s_bar_w, s_bar_h, COL_WHITE);
        s_disp->fill_rect(s_bar_x + 1, s_bar_y + 1, s_bar_w - 2, s_bar_h - 2, COL_BLACK);
    }

    // One line's worth of room below the bar for purr_splash_status().
    s_status_y = (int16_t)(s_bar_y + s_bar_h + 8);

    const char *credit = "(c) PURR OS";
    draw_str(4, (int)info.height - FONT_H - 4, credit, COL_WHITE, COL_BLACK, 1);

    s_step = 0;
}

void purr_splash_advance(void)
{
    if (!s_disp || !s_disp->fill_rect) return;
    if (s_step >= s_steps) return;
    s_step++;

    int16_t filled = (int16_t)((s_bar_w - 2) * s_step / s_steps);
    if (filled > 0) s_disp->fill_rect(s_bar_x + 1, s_bar_y + 1, filled, s_bar_h - 2, COL_WHITE);
}

// Single status line under the bar. Clears the previous line first, so callers
// can update it freely without accumulating overdraw.
//
// Truncated rather than wrapped: this exists to name one short thing that is
// happening right now ("unloading meshtastic"), and a second line would push the
// layout around mid-transition, which looks like a fault rather than progress.
void purr_splash_status(const char *line)
{
    if (!s_disp || !s_disp->fill_rect || s_status_y == 0) return;

    s_disp->fill_rect(0, s_status_y, s_scr_w, FONT_H, COL_BLACK);
    if (!line || !*line) return;

    int max_chars = (int)(s_scr_w / FONT_W) - 2;
    if (max_chars < 1) return;

    char buf[64];
    int n = (int)strlen(line);
    if (n > max_chars) n = max_chars;
    if (n > (int)sizeof(buf) - 1) n = (int)sizeof(buf) - 1;
    memcpy(buf, line, (size_t)n);
    buf[n] = '\0';

    draw_str((s_scr_w - str_width(buf, 1)) / 2, s_status_y, buf, COL_WHITE, COL_BLACK, 1);
}

// ── Boot splash wrappers ────────────────────────────────────────────────────
// Kept as distinct names because several device kernels call them and the title
// is part of what the OS looks like at boot.

void boot_splash_show(void)    { purr_splash_show("Starting PURR OS...", BOOT_SPLASH_STEPS); }
void boot_splash_advance(void) { purr_splash_advance(); }
