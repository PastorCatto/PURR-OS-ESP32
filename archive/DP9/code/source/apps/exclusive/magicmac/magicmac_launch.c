// magicmac_launch.c — MagicMac pre-launch screen
//
// Draws directly via catcall_display (fill_rect + push_pixels).
// No MiniWin, no LVGL — intentionally minimal.
// A tiny 8x8 bitmap font handles all text rendering.

#include "magicmac_launch.h"
#include "../../../kernel/core/purr_kernel.h"
#include "esp_log.h"
#include "freertos/FreeRTOS.h"
#include "freertos/task.h"
#include <stdio.h>
#include <string.h>
#include <stdbool.h>

static const char *TAG = "magicmac_launch";

// ── Minimal 8×8 bitmap font (printable ASCII 0x20–0x7E) ──────────────────────
// Each character = 8 bytes, one byte per row, MSB = leftmost pixel.
// Derived from the IBM CP437 8x8 font (public domain).

static const uint8_t s_font8x8[95][8] = {
    {0x00,0x00,0x00,0x00,0x00,0x00,0x00,0x00}, // 0x20 SPACE
    {0x18,0x3C,0x3C,0x18,0x18,0x00,0x18,0x00}, // 0x21 !
    {0x36,0x36,0x00,0x00,0x00,0x00,0x00,0x00}, // 0x22 "
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    {0x6E,0x3B,0x00,0x00,0x00,0x00,0x00,0x00}, // 0x7E ~
};

// ── Drawing primitives ────────────────────────────────────────────────────────

static uint16_t s_disp_w = 320;
static uint16_t s_disp_h = 240;

// Single row of pixels, wide enough for the display
static uint16_t s_row_buf[512];

static void draw_fill(int x, int y, int w, int h, uint16_t color)
{
    const catcall_display_t *d = purr_kernel_display();
    if (!d) return;
    d->fill_rect(x, y, w, h, color);
}

// Draw one 8x8 character at (cx, cy) in fg/bg RGB565
static void draw_char(int cx, int cy, char ch, uint16_t fg, uint16_t bg)
{
    const catcall_display_t *d = purr_kernel_display();
    if (!d) return;
    if (ch < 0x20 || ch > 0x7E) ch = '?';
    const uint8_t *glyph = s_font8x8[(uint8_t)ch - 0x20];
    for (int row = 0; row < 8; row++) {
        uint8_t bits = glyph[row];
        for (int col = 0; col < 8; col++) {
            s_row_buf[col] = (bits & (0x80 >> col)) ? fg : bg;
        }
        d->push_pixels(cx, cy + row, 8, 1, s_row_buf);
    }
}

// Draw a null-terminated string. Scale factor: 1=8px, 2=16px chars.
static void draw_string(int x, int y, const char *str, uint16_t fg, uint16_t bg, int scale)
{
    const catcall_display_t *d = purr_kernel_display();
    if (!d) return;
    int cx = x;
    while (*str) {
        if (scale == 1) {
            draw_char(cx, y, *str, fg, bg);
            cx += 8;
        } else {
            // Upscale: render 8x8 glyph into scale*8 x scale*8
            const uint8_t *glyph = s_font8x8[(*str < 0x20 || *str > 0x7E) ? 0 : (uint8_t)*str - 0x20];
            for (int row = 0; row < 8; row++) {
                uint8_t bits = glyph[row];
                for (int col = 0; col < 8; col++) {
                    uint16_t c = (bits & (0x80 >> col)) ? fg : bg;
                    for (int sc = 0; sc < scale; sc++) s_row_buf[col * scale + sc] = c;
                }
                for (int sr = 0; sr < scale; sr++) {
                    d->push_pixels(cx, y + row * scale + sr, 8 * scale, 1, s_row_buf);
                }
            }
            cx += 8 * scale;
        }
        str++;
    }
}

static int str_px_width(const char *s, int scale) { return (int)strlen(s) * 8 * scale; }

static void draw_centered(int y, const char *str, uint16_t fg, uint16_t bg, int scale)
{
    int x = (s_disp_w - str_px_width(str, scale)) / 2;
    if (x < 0) x = 0;
    draw_string(x, y, str, fg, bg, scale);
}

// ── Colours (RGB565) ──────────────────────────────────────────────────────────
#define COL_BLACK    0x0000u
#define COL_WHITE    0xFFFFu
#define COL_GREY     0x8410u
#define COL_DARKGREY 0x4208u
#define COL_RED      0xD800u
#define COL_YELLOW   0xFFE0u
#define COL_GREEN    0x07E0u
#define COL_BLUE     0x001Fu
#define COL_ORANGE   0xFC60u

// ── Button hit-test ───────────────────────────────────────────────────────────
typedef struct { int x, y, w, h; } btn_rect_t;

static bool btn_hit(const btn_rect_t *b, int tx, int ty)
{
    return tx >= b->x && tx < b->x + b->w &&
           ty >= b->y && ty < b->y + b->h;
}

static void draw_button(const btn_rect_t *b, const char *label, uint16_t bg, uint16_t fg)
{
    draw_fill(b->x, b->y, b->w, b->h, bg);
    // 1px border in white
    draw_fill(b->x,           b->y,           b->w, 1,    COL_WHITE);
    draw_fill(b->x,           b->y + b->h - 1, b->w, 1,   COL_WHITE);
    draw_fill(b->x,           b->y,           1,    b->h, COL_WHITE);
    draw_fill(b->x + b->w - 1, b->y,           1,    b->h, COL_WHITE);
    // Centered label
    int lx = b->x + (b->w - str_px_width(label, 1)) / 2;
    int ly = b->y + (b->h - 8) / 2;
    draw_string(lx, ly, label, fg, bg, 1);
}

// ── Screens ───────────────────────────────────────────────────────────────────

static void draw_loading_screen(void)
{
    draw_fill(0, 0, s_disp_w, s_disp_h, COL_BLACK);
    draw_centered(s_disp_h / 2 - 24, "PURR OS", COL_WHITE, COL_BLACK, 2);
    draw_centered(s_disp_h / 2,      "MagicMac", COL_GREY, COL_BLACK, 1);
    draw_centered(s_disp_h / 2 + 20, "Loading ROM...", COL_GREY, COL_BLACK, 1);
}

static void draw_found_screen(void)
{
    draw_fill(0, 0, s_disp_w, s_disp_h, COL_BLACK);
    draw_centered(s_disp_h / 2 - 16, "ROM found.", COL_GREEN, COL_BLACK, 1);
    draw_centered(s_disp_h / 2,      "Starting emulator...", COL_GREY, COL_BLACK, 1);
}

static btn_rect_t s_reboot_btn;
static btn_rect_t s_ignore_btn;

static void draw_missing_screen(const char *tried_path)
{
    draw_fill(0, 0, s_disp_w, s_disp_h, COL_BLACK);

    // Warning panel
    int panel_h = s_disp_h - 40;
    draw_fill(8, 8, s_disp_w - 16, panel_h, 0x8000u); // dark red

    draw_centered(18, "ROM NOT FOUND", COL_YELLOW, 0x8000u, 2);
    draw_centered(46, "MagicMac needs a 512KB", COL_WHITE, 0x8000u, 1);
    draw_centered(58, "Mac Plus ROM image.", COL_WHITE, 0x8000u, 1);
    draw_centered(74, tried_path, COL_GREY,  0x8000u, 1);
    draw_centered(90, "See docs/08_Exclusives.md", COL_GREY, 0x8000u, 1);

    // Buttons
    int bw = 80, bh = 24;
    int by = s_disp_h - 36;

    s_reboot_btn = (btn_rect_t){ s_disp_w/2 - bw - 8, by, bw, bh };
    s_ignore_btn = (btn_rect_t){ s_disp_w/2 + 8,       by, bw, bh };

    draw_button(&s_reboot_btn, "REBOOT", COL_RED,  COL_WHITE);
    draw_button(&s_ignore_btn, "IGNORE", COL_GREY, COL_WHITE);
}

// ── Main entry ────────────────────────────────────────────────────────────────

bool magicmac_launch(const magicmac_cfg_t *cfg)
{
    const catcall_display_t *disp  = purr_kernel_display();
    const catcall_touch_t   *touch = purr_kernel_touch();

    if (!disp) {
        ESP_LOGE(TAG, "no display catcall — cannot show launch screen");
        return false;
    }

    // Resolve display dimensions
    display_info_t info = {0};
    disp->get_info(&info);
    s_disp_w = cfg->display_w ? cfg->display_w : info.width;
    s_disp_h = cfg->display_h ? cfg->display_h : info.height;

    // --- LOADING screen ---
    draw_loading_screen();
    vTaskDelay(pdMS_TO_TICKS(400)); // brief pause so it's readable

    // --- ROM check ---
    FILE *f = fopen(cfg->rom_path, "rb");
    if (f) {
        fclose(f);
        // ROM found
        draw_found_screen();
        vTaskDelay(pdMS_TO_TICKS(800));
        return true;
    }

    // Try flash fallback
    f = fopen(MAGICMAC_DEFAULT_ROM_FB, "rb");
    if (f) {
        fclose(f);
        draw_found_screen();
        vTaskDelay(pdMS_TO_TICKS(800));
        return true;
    }

    // --- ROM MISSING — warning screen ---
    ESP_LOGW(TAG, "ROM not found at %s or %s", cfg->rom_path, MAGICMAC_DEFAULT_ROM_FB);
    draw_missing_screen(cfg->rom_path);

    if (!touch) {
        ESP_LOGW(TAG, "no touch — waiting 10s then returning false");
        vTaskDelay(pdMS_TO_TICKS(10000));
        return false;
    }

    // Poll for button presses
    while (1) {
        int16_t tx, ty;
        if (touch->is_pressed() && touch->read_point(&tx, &ty)) {
            vTaskDelay(pdMS_TO_TICKS(50)); // debounce
            if (btn_hit(&s_reboot_btn, tx, ty)) {
                ESP_LOGI(TAG, "reboot pressed");
                draw_fill(s_reboot_btn.x, s_reboot_btn.y,
                          s_reboot_btn.w, s_reboot_btn.h, COL_WHITE);
                vTaskDelay(pdMS_TO_TICKS(120));
                purr_kernel_reboot();
                // never returns
            }
            if (btn_hit(&s_ignore_btn, tx, ty)) {
                ESP_LOGI(TAG, "ignore pressed — continuing without ROM");
                return false;
            }
        }
        vTaskDelay(pdMS_TO_TICKS(30));
    }
}
