#include "display_axs.h"
#include <string.h>
#include "freertos/FreeRTOS.h"
#include "freertos/task.h"
#include "freertos/semphr.h"
#include "esp_log.h"
#include "esp_err.h"
#include "esp_heap_caps.h"
#include "driver/gpio.h"
#include "driver/spi_master.h"
#include "esp_lcd_panel_io.h"
#include "esp_lcd_panel_ops.h"
#include "esp_lcd_axs15231b.h"

static const char *TAG = "display_axs";

extern const uint8_t font8x8_basic[128][8];

/* ---------------- Hardware pin map (JC3248W535, from ESP32S3_QR) ---------------- */
#define LCD_HOST     SPI2_HOST
#define LCD_PCLK_HZ  (40 * 1000 * 1000)
#define LCD_BPP      16

#define PIN_LCD_CS   45
#define PIN_LCD_PCLK 47
#define PIN_LCD_D0   21
#define PIN_LCD_D1   48
#define PIN_LCD_D2   40
#define PIN_LCD_D3   39
#define PIN_LCD_RST  -1
#define PIN_LCD_BL   1

#define BOUNCE_LINES 40

/* ---------------- State ---------------- */
static esp_lcd_panel_handle_t    s_panel = NULL;
static esp_lcd_panel_io_handle_t s_io    = NULL;
static uint16_t                 *s_fb     = NULL;   // PSRAM framebuffer (native RGB565)
static uint16_t                 *s_bounce = NULL;   // internal DMA bounce buffer
static SemaphoreHandle_t         s_fb_mux = NULL;
static SemaphoreHandle_t         s_flush_done = NULL;

static uint16_t s_fg = 0xFFFF;
static uint16_t s_bg = 0x0000;

/* ---------------- Vendor init sequence (Guition AXS15231B) ----------------
 * Sourced verbatim from the working ESP32S3_QR bring-up (esp-iot-solution#579). */
static const axs15231b_lcd_init_cmd_t lcd_init_cmds[] = {
    {0xBB, (uint8_t[]){0x00,0x00,0x00,0x00,0x00,0x00,0x5A,0xA5}, 8, 0},
    {0xA0, (uint8_t[]){0xC0,0x10,0x00,0x02,0x00,0x00,0x04,0x3F,0x20,0x05,0x3F,0x3F,0x00,0x00,0x00,0x00,0x00}, 17, 0},
    {0xA2, (uint8_t[]){0x30,0x3C,0x24,0x14,0xD0,0x20,0xFF,0xE0,0x40,0x19,0x80,0x80,0x80,0x20,0xF9,0x10,0x02,0xFF,0xFF,0xF0,0x90,0x01,0x32,0xA0,0x91,0xE0,0x20,0x7F,0xFF,0x00,0x5A}, 31, 0},
    {0xD0, (uint8_t[]){0xE0,0x40,0x51,0x24,0x08,0x05,0x10,0x01,0x20,0x15,0x42,0xC2,0x22,0x22,0xAA,0x03,0x10,0x12,0x60,0x14,0x1E,0x51,0x15,0x00,0x8A,0x20,0x00,0x03,0x3A,0x12}, 30, 0},
    {0xA3, (uint8_t[]){0xA0,0x06,0xAA,0x00,0x08,0x02,0x0A,0x04,0x04,0x04,0x04,0x04,0x04,0x04,0x04,0x04,0x04,0x04,0x04,0x00,0x55,0x55}, 22, 0},
    {0xC1, (uint8_t[]){0x31,0x04,0x02,0x02,0x71,0x05,0x24,0x55,0x02,0x00,0x41,0x00,0x53,0xFF,0xFF,0xFF,0x4F,0x52,0x00,0x4F,0x52,0x00,0x45,0x3B,0x0B,0x02,0x0D,0x00,0xFF,0x40}, 30, 0},
    {0xC3, (uint8_t[]){0x00,0x00,0x00,0x50,0x03,0x00,0x00,0x00,0x01,0x80,0x01}, 11, 0},
    {0xC4, (uint8_t[]){0x00,0x24,0x33,0x80,0x00,0xEA,0x64,0x32,0xC8,0x64,0xC8,0x32,0x90,0x90,0x11,0x06,0xDC,0xFA,0x00,0x00,0x80,0xFE,0x10,0x10,0x00,0x0A,0x0A,0x44,0x50}, 29, 0},
    {0xC5, (uint8_t[]){0x18,0x00,0x00,0x03,0xFE,0x3A,0x4A,0x20,0x30,0x10,0x88,0xDE,0x0D,0x08,0x0F,0x0F,0x01,0x3A,0x4A,0x20,0x10,0x10,0x00}, 23, 0},
    {0xC6, (uint8_t[]){0x05,0x0A,0x05,0x0A,0x00,0xE0,0x2E,0x0B,0x12,0x22,0x12,0x22,0x01,0x03,0x00,0x3F,0x6A,0x18,0xC8,0x22}, 20, 0},
    {0xC7, (uint8_t[]){0x50,0x32,0x28,0x00,0xA2,0x80,0x8F,0x00,0x80,0xFF,0x07,0x11,0x9C,0x67,0xFF,0x24,0x0C,0x0D,0x0E,0x0F}, 20, 0},
    {0xC9, (uint8_t[]){0x33,0x44,0x44,0x01}, 4, 0},
    {0xCF, (uint8_t[]){0x2C,0x1E,0x88,0x58,0x13,0x18,0x56,0x18,0x1E,0x68,0x88,0x00,0x65,0x09,0x22,0xC4,0x0C,0x77,0x22,0x44,0xAA,0x55,0x08,0x08,0x12,0xA0,0x08}, 27, 0},
    {0xD5, (uint8_t[]){0x40,0x8E,0x8D,0x01,0x35,0x04,0x92,0x74,0x04,0x92,0x74,0x04,0x08,0x6A,0x04,0x46,0x03,0x03,0x03,0x03,0x82,0x01,0x03,0x00,0xE0,0x51,0xA1,0x00,0x00,0x00}, 30, 0},
    {0xD6, (uint8_t[]){0x10,0x32,0x54,0x76,0x98,0xBA,0xDC,0xFE,0x93,0x00,0x01,0x83,0x07,0x07,0x00,0x07,0x07,0x00,0x03,0x03,0x03,0x03,0x03,0x03,0x00,0x84,0x00,0x20,0x01,0x00}, 30, 0},
    {0xD7, (uint8_t[]){0x03,0x01,0x0B,0x09,0x0F,0x0D,0x1E,0x1F,0x18,0x1D,0x1F,0x19,0x40,0x8E,0x04,0x00,0x20,0xA0,0x1F}, 19, 0},
    {0xD8, (uint8_t[]){0x02,0x00,0x0A,0x08,0x0E,0x0C,0x1E,0x1F,0x18,0x1D,0x1F,0x19}, 12, 0},
    {0xD9, (uint8_t[]){0x1F,0x1F,0x1F,0x1F,0x1F,0x1F,0x1F,0x1F,0x1F,0x1F,0x1F,0x1F}, 12, 0},
    {0xDD, (uint8_t[]){0x1F,0x1F,0x1F,0x1F,0x1F,0x1F,0x1F,0x1F,0x1F,0x1F,0x1F,0x1F}, 12, 0},
    {0xDF, (uint8_t[]){0x44,0x73,0x4B,0x69,0x00,0x0A,0x02,0x90}, 8, 0},
    {0xE0, (uint8_t[]){0x3B,0x28,0x10,0x16,0x0C,0x06,0x11,0x28,0x5C,0x21,0x0D,0x35,0x13,0x2C,0x33,0x28,0x0D}, 17, 0},
    {0xE1, (uint8_t[]){0x37,0x28,0x10,0x16,0x0B,0x06,0x11,0x28,0x5C,0x21,0x0D,0x35,0x14,0x2C,0x33,0x28,0x0F}, 17, 0},
    {0xE2, (uint8_t[]){0x3B,0x07,0x12,0x18,0x0E,0x0D,0x17,0x35,0x44,0x32,0x0C,0x14,0x14,0x36,0x3A,0x2F,0x0D}, 17, 0},
    {0xE3, (uint8_t[]){0x37,0x07,0x12,0x18,0x0E,0x0D,0x17,0x35,0x44,0x32,0x0C,0x14,0x14,0x36,0x32,0x2F,0x0F}, 17, 0},
    {0xE4, (uint8_t[]){0x3B,0x07,0x12,0x18,0x0E,0x0D,0x17,0x39,0x44,0x2E,0x0C,0x14,0x14,0x36,0x3A,0x2F,0x0D}, 17, 0},
    {0xE5, (uint8_t[]){0x37,0x07,0x12,0x18,0x0E,0x0D,0x17,0x39,0x44,0x2E,0x0C,0x14,0x14,0x36,0x3A,0x2F,0x0F}, 17, 0},
    {0xA4, (uint8_t[]){0x85,0x85,0x95,0x82,0xAF,0xAA,0xAA,0x80,0x10,0x30,0x40,0x40,0x20,0xFF,0x60,0x30}, 16, 0},
    {0xA4, (uint8_t[]){0x85,0x85,0x95,0x85}, 4, 0},
    {0xBB, (uint8_t[]){0x00,0x00,0x00,0x00,0x00,0x00,0x00,0x00}, 8, 0},
    {0x13, (uint8_t[]){0x00}, 0, 0},
    {0x11, (uint8_t[]){0x00}, 0, 120},   /* sleep out, 120 ms */
    {0x29, (uint8_t[]){0x00}, 0, 10},    /* display on */
};

/* ---------------- Panel flush ---------------- */
static bool IRAM_ATTR on_color_trans_done(esp_lcd_panel_io_handle_t io,
                                          esp_lcd_panel_io_event_data_t *e,
                                          void *ctx) {
    BaseType_t hpw = pdFALSE;
    xSemaphoreGiveFromISR(s_flush_done, &hpw);
    return hpw == pdTRUE;
}

void display_axs_flush(void) {
    if (!s_panel || !s_fb) return;
    xSemaphoreTake(s_fb_mux, portMAX_DELAY);
    for (int y = 0; y < AXS_LCD_H; y += BOUNCE_LINES) {
        int y_end = y + BOUNCE_LINES;
        if (y_end > AXS_LCD_H) y_end = AXS_LCD_H;
        size_t px = (size_t)AXS_LCD_W * (y_end - y);
        const uint16_t *src = s_fb + (size_t)y * AXS_LCD_W;
        for (size_t i = 0; i < px; i++) s_bounce[i] = __builtin_bswap16(src[i]);
        esp_lcd_panel_draw_bitmap(s_panel, 0, y, AXS_LCD_W, y_end, s_bounce);
        xSemaphoreTake(s_flush_done, portMAX_DELAY);
    }
    xSemaphoreGive(s_fb_mux);
}

/* The AXS15231B blanks after idle — repaint on a timer so it stays lit. */
static void refresh_task(void *arg) {
    while (1) {
        display_axs_flush();
        vTaskDelay(pdMS_TO_TICKS(150));
    }
}

/* ---------------- Drawing (into framebuffer) ---------------- */
static inline void put_px(int x, int y, uint16_t c) {
    if (x < 0 || y < 0 || x >= AXS_LCD_W || y >= AXS_LCD_H) return;
    s_fb[(size_t)y * AXS_LCD_W + x] = c;
}

void display_axs_fill_rect(int16_t x, int16_t y, int16_t w, int16_t h, uint16_t color) {
    if (!s_fb) return;
    xSemaphoreTake(s_fb_mux, portMAX_DELAY);
    for (int yy = y; yy < y + h; yy++)
        for (int xx = x; xx < x + w; xx++)
            put_px(xx, yy, color);
    xSemaphoreGive(s_fb_mux);
}

void display_axs_draw_hline(int16_t x, int16_t y, int16_t w, uint16_t color) {
    display_axs_fill_rect(x, y, w, 1, color);
}

void display_axs_clear(void) {
    if (!s_fb) return;
    xSemaphoreTake(s_fb_mux, portMAX_DELAY);
    for (size_t i = 0; i < (size_t)AXS_LCD_W * AXS_LCD_H; i++) s_fb[i] = s_bg;
    xSemaphoreGive(s_fb_mux);
}

void display_axs_set_text_colors(uint16_t fg565, uint16_t bg565) {
    s_fg = fg565;
    s_bg = bg565;
}

static void draw_char(int x, int y, char ch, uint16_t fg, uint16_t bg, uint8_t size) {
    uint8_t c = (uint8_t)ch;
    if (c > 0x7F) c = '?';
    const uint8_t *glyph = font8x8_basic[c];
    for (int row = 0; row < 8; row++) {
        uint8_t bits = glyph[row];
        for (int col = 0; col < 8; col++) {
            uint16_t color = (bits & (1 << col)) ? fg : bg;
            for (int dy = 0; dy < size; dy++)
                for (int dx = 0; dx < size; dx++)
                    put_px(x + col * size + dx, y + row * size + dy, color);
        }
    }
}

void display_axs_draw_string(int16_t x, int16_t y, const char* s,
                             uint16_t fg, uint16_t bg, uint8_t size) {
    if (!s_fb || !s) return;
    if (size == 0) size = 1;
    xSemaphoreTake(s_fb_mux, portMAX_DELAY);
    int cx = x;
    for (const char* p = s; *p; p++) {
        if (*p == '\n') { cx = x; y += 8 * size + 2; continue; }
        draw_char(cx, y, *p, fg, bg, size);
        cx += 8 * size;
    }
    xSemaphoreGive(s_fb_mux);
}

void display_axs_text(uint8_t row, const char* text) {
    display_axs_draw_string(4, 4 + row * 18, text, s_fg, s_bg, 2);
}

/* ---------------- Backlight ---------------- */
void display_axs_set_brightness(uint8_t level) {
    gpio_set_level(PIN_LCD_BL, level ? 1 : 0);
}

/* ---------------- Bring-up ---------------- */
void display_axs_init(void) {
    // Backlight on
    gpio_config_t bk = { .mode = GPIO_MODE_OUTPUT, .pin_bit_mask = 1ULL << PIN_LCD_BL };
    ESP_ERROR_CHECK(gpio_config(&bk));
    gpio_set_level(PIN_LCD_BL, 1);

    // Buffers
    s_fb = heap_caps_malloc((size_t)AXS_LCD_W * AXS_LCD_H * sizeof(uint16_t),
                            MALLOC_CAP_SPIRAM | MALLOC_CAP_8BIT);
    s_bounce = heap_caps_malloc((size_t)AXS_LCD_W * BOUNCE_LINES * sizeof(uint16_t),
                                MALLOC_CAP_DMA | MALLOC_CAP_INTERNAL);
    assert(s_fb && s_bounce);
    memset(s_fb, 0, (size_t)AXS_LCD_W * AXS_LCD_H * sizeof(uint16_t));

    s_fb_mux     = xSemaphoreCreateMutex();
    s_flush_done = xSemaphoreCreateBinary();

    // QSPI bus
    ESP_LOGI(TAG, "init QSPI bus");
    spi_bus_config_t bus_cfg = AXS15231B_PANEL_BUS_QSPI_CONFIG(
        PIN_LCD_PCLK, PIN_LCD_D0, PIN_LCD_D1, PIN_LCD_D2, PIN_LCD_D3,
        AXS_LCD_W * BOUNCE_LINES * sizeof(uint16_t) + 8);
    ESP_ERROR_CHECK(spi_bus_initialize(LCD_HOST, &bus_cfg, SPI_DMA_CH_AUTO));

    // Panel IO
    esp_lcd_panel_io_spi_config_t io_cfg = AXS15231B_PANEL_IO_QSPI_CONFIG(PIN_LCD_CS, NULL, NULL);
    ESP_ERROR_CHECK(esp_lcd_new_panel_io_spi((esp_lcd_spi_bus_handle_t)LCD_HOST, &io_cfg, &s_io));

    // Panel + vendor init
    ESP_LOGI(TAG, "init AXS15231B panel");
    axs15231b_vendor_config_t vendor_cfg = {
        .init_cmds      = lcd_init_cmds,
        .init_cmds_size = sizeof(lcd_init_cmds) / sizeof(lcd_init_cmds[0]),
        .flags = { .use_qspi_interface = 1 },
    };
    esp_lcd_panel_dev_config_t panel_cfg = {
        .reset_gpio_num = PIN_LCD_RST,
        .rgb_ele_order  = LCD_RGB_ELEMENT_ORDER_RGB,
        .bits_per_pixel = LCD_BPP,
        .data_endian    = LCD_RGB_DATA_ENDIAN_BIG,
        .vendor_config  = &vendor_cfg,
    };
    ESP_ERROR_CHECK(esp_lcd_new_panel_axs15231b(s_io, &panel_cfg, &s_panel));
    ESP_ERROR_CHECK(esp_lcd_panel_reset(s_panel));
    ESP_ERROR_CHECK(esp_lcd_panel_init(s_panel));
    // (vendor sequence already issued sleep-out + display-on)

    esp_lcd_panel_io_callbacks_t cbs = { .on_color_trans_done = on_color_trans_done };
    ESP_ERROR_CHECK(esp_lcd_panel_io_register_event_callbacks(s_io, &cbs, NULL));

    xTaskCreatePinnedToCore(refresh_task, "axs_refresh", 4096, NULL, 4, NULL, 0);
    ESP_LOGI(TAG, "AXS15231B ready %dx%d", AXS_LCD_W, AXS_LCD_H);
}
