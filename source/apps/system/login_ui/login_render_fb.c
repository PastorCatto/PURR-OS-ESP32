// login_render_fb.c — plain framebuffer render backend for loginUI.
//
// Compiled only when catstrap's "fb" sysclaw variant is built
// (-DLOGIN_UI_BACKEND_FB, see catstrap.py's _build_sysclaw_variant()) —
// the #if below makes this an empty translation unit otherwise, so both
// backend .c files can always be handed to the compiler unconditionally
// without the "lvgl" variant accidentally pulling this one in too.
#if defined(LOGIN_UI_BACKEND_FB)

#include "login_core.h"
#include <stdint.h>
#include <stdbool.h>
#include <string.h>

// Hand-declared mirror of catcall_display.h — no #include of the real
// header in this standalone compile (see app.pcat's own comment). Field-
// for-field confirmed against source/kernel/catcalls/catcall_display.h
// (CATCALL_DISPLAY_VERSION 3) before writing this — same convention
// claw_loader_selftest.c's guest_ui_o_bytes established. Keyboard input
// does NOT need a catcall_input_t mirror at all — see purr_kernel_poll_
// key()'s own doc comment on why a loaded module calls that instead of
// reaching into a driver struct's own function-pointer members directly.
typedef int32_t esp_err_t;

typedef struct {
    uint16_t width;
    uint16_t height;
    uint8_t  bits_per_pixel;
    char     name[32];
} display_info_t;

typedef struct {
    const char *name;
    uint8_t     catcall_version;
    esp_err_t (*init)(const void *cfg);
    esp_err_t (*push_pixels)(int x, int y, int w, int h, const uint16_t *data);
    esp_err_t (*fill_rect)(int x, int y, int w, int h, uint16_t color);
    esp_err_t (*set_brightness)(uint8_t level);
    void      (*get_info)(display_info_t *out);
    esp_err_t (*deinit)(void);
    esp_err_t (*push_pixels_async)(int x, int y, int w, int h, int stride, const uint16_t *data);
    void      (*flush_done_cb)(void (*cb)(void *user), void *user);
} catcall_display_t;

extern const catcall_display_t *purr_kernel_display(void);
extern int                       purr_kernel_poll_key(void);

#define FONT_W 6
#define FONT_H 8
#define FG_COLOR 0xFFFFu
#define BG_COLOR 0x0000u
#define ERR_COLOR 0xF800u   // red (RGB565) — password field outline on failure

// Font table — copied, not shared, from purr_fbtty.c's own copy (which
// itself was copied from boot_splash.c) — same "must stay independently
// linkable" reasoning every one of those files' own comments already
// gives, doubly true here: this file compiles in complete isolation via
// catstrap's sysclaw pipeline, with no access to any other module's
// translation unit at all. ASCII 0x20..0x7E.
static const uint8_t s_font6x8[][6] = {
    {0x00,0x00,0x00,0x00,0x00,0x00}, {0x00,0x00,0x5F,0x00,0x00,0x00},
    {0x00,0x07,0x00,0x07,0x00,0x00}, {0x14,0x7F,0x14,0x7F,0x14,0x00},
    {0x24,0x2A,0x7F,0x2A,0x12,0x00}, {0x23,0x13,0x08,0x64,0x62,0x00},
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    {0x08,0x04,0x08,0x10,0x08,0x00},
};

static const catcall_display_t *s_disp = NULL;
static int s_scr_w = 0, s_scr_h = 0;

static void draw_char(int px, int py, char c, uint16_t fg)
{
    if (c < 0x20 || c > 0x7E) c = ' ';
    const uint8_t *glyph = s_font6x8[(unsigned char)c - 0x20];
    uint16_t buf[FONT_W * FONT_H];
    for (int cx = 0; cx < FONT_W; cx++) {
        uint8_t bits = glyph[cx];
        for (int cy = 0; cy < FONT_H; cy++) {
            buf[cy * FONT_W + cx] = (bits & (1 << cy)) ? fg : BG_COLOR;
        }
    }
    s_disp->push_pixels(px, py, FONT_W, FONT_H, buf);
}

static void draw_str(int px, int py, const char *s, uint16_t fg)
{
    while (*s) {
        draw_char(px, py, *s, fg);
        px += FONT_W;
        s++;
    }
}

// Clears a field's drawing area (label width fixed, value area cleared
// fresh each redraw so a shorter new value doesn't leave old glyphs
// trailing after it — same reasoning boot_splash.c's own status-line
// clear-then-redraw already documents).
static void clear_row(int py, int w)
{
    s_disp->fill_rect(0, py, w, FONT_H, BG_COLOR);
}

#define ROW_TITLE  1
#define ROW_MOTD   2
#define ROW_USER   4
#define ROW_PASS   5
#define ROW_STATUS 7

static void redraw(const login_core_t *lc)
{
    int y_user   = ROW_USER  * FONT_H;
    int y_pass   = ROW_PASS  * FONT_H;
    int y_status = ROW_STATUS * FONT_H;

    clear_row(y_user, s_scr_w);
    clear_row(y_pass, s_scr_w);
    clear_row(y_status, s_scr_w);

    char line[LOGIN_USERNAME_MAX + 16];
    int n = 0;
    const char *p = "login: ";
    while (*p) line[n++] = *p++;
    p = lc->username;
    while (*p) line[n++] = *p++;
    if (lc->state == LOGIN_STATE_USERNAME) line[n++] = '_';
    line[n] = '\0';
    draw_str(FONT_W, y_user, line, FG_COLOR);

    if (lc->state == LOGIN_STATE_PASSWORD || lc->state == LOGIN_STATE_ERROR ||
        lc->state == LOGIN_STATE_SUCCESS) {
        n = 0;
        p = "password: ";
        while (*p) line[n++] = *p++;
        for (int i = 0; i < lc->p_len; i++) line[n++] = '*';
        if (lc->state == LOGIN_STATE_PASSWORD) line[n++] = '_';
        line[n] = '\0';
        uint16_t pw_color = (lc->state == LOGIN_STATE_ERROR) ? ERR_COLOR : FG_COLOR;
        draw_str(FONT_W, y_pass, line, pw_color);
    }

    if (lc->state == LOGIN_STATE_ERROR && lc->error_msg) {
        draw_str(FONT_W, y_status, lc->error_msg, ERR_COLOR);
    } else if (lc->state == LOGIN_STATE_SUCCESS) {
        draw_str(FONT_W, y_status, "Login successful.", FG_COLOR);
    }
}

bool login_render_init(void)
{
    s_disp = purr_kernel_display();
    if (!s_disp || !s_disp->get_info || !s_disp->fill_rect || !s_disp->push_pixels) return false;

    display_info_t info;
    s_disp->get_info(&info);
    s_scr_w = info.width;
    s_scr_h = info.height;
    if (s_scr_w <= 0 || s_scr_h <= 0) return false;

    s_disp->fill_rect(0, 0, s_scr_w, s_scr_h, BG_COLOR);
    draw_str(FONT_W, ROW_TITLE * FONT_H, "Welcome to PURR OS", FG_COLOR);
    return true;
}

// Drawn once, the first call only — lc->motd never changes after
// login_ui_main.c's own load_motd() runs, unlike username/password/state
// which redraw() below repaints on every call.
static bool s_motd_drawn = false;

void login_render_draw(const login_core_t *lc)
{
    if (!s_disp) return;
    if (!s_motd_drawn && lc->motd[0]) {
        draw_str(FONT_W, ROW_MOTD * FONT_H, lc->motd, FG_COLOR);
        s_motd_drawn = true;
    }
    redraw(lc);
}

// Non-blocking: a raw keycode byte (ASCII — same convention purr_fbtty.c's
// own fbtty_read_byte() already established: a driver's KEY_DOWN keycode
// IS the ASCII byte, no HID translation layer exists or is needed today),
// or -1 if nothing arrived. purr_kernel_poll_key() itself polls every
// registered input, not just the first — see its own doc comment.
int login_render_poll_key(void)
{
    return purr_kernel_poll_key();
}

#endif // LOGIN_UI_BACKEND_FB
