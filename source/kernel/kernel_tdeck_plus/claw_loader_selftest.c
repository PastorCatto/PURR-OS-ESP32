// claw_loader_selftest.c — TEMPORARY. Exercises the real, promoted
// claw_loader module (source/modules/claw_loader/) end-to-end: resolving
// BOTH claw_personal_init/claw_personal_deinit by name (rounds 1-3 of the
// R&D spike this was promoted from only ever resolved one entry symbol at
// a time), calling init(), then deinit(), then unloading.
//
// guest3_o_bytes is a standalone compile of:
//
//   static int s_init_count = 0;
//   static const char tag[] = "loaded-ok";
//   int claw_personal_init(void) {
//       s_init_count++;
//       return (int)tag[0] + s_init_count;   // 'l' (108) + 1 = 109 on first call
//   }
//   void claw_personal_deinit(void) { s_init_count = 0; }
//
// Compiled: xtensa-esp32s3-elf-gcc -mtext-section-literals -mlongcalls -O0 -c
//
// guest4_o_bytes (below, second test) closes the gap this file's own
// comment used to note here: a loaded module calling a REAL host function
// BY NAME (purr_kernel_uptime_ms(), resolved via claw_loader.c's import
// table / claw_elf.h's CLAW_SEC_EXTERN — piece 1 of the "named-host-
// function import table" work), not through a parameter it was handed
// (round 2's callback trick already proved that path). It's a standalone
// compile of:
//
//   #include <stdint.h>
//   extern uint64_t purr_kernel_uptime_ms(void);
//   static uint64_t s_last_uptime = 0;
//   int claw_personal_init(void) {
//       s_last_uptime = purr_kernel_uptime_ms();
//       return (int)(s_last_uptime & 0x7fffffff);
//   }
//   void claw_personal_deinit(void) { s_last_uptime = 0; }
//
// Compiled: xtensa-esp32s3-elf-gcc -mtext-section-literals -mlongcalls -O0 -c
// objdump -r confirmed a R_XTENSA_32 relocation in .text pointing at the
// UNDEFINED symbol "purr_kernel_uptime_ms" (SHN_UNDEF) — exactly the case
// claw_elf.c's resolve_import() exists to handle — plus an
// R_XTENSA_ASM_EXPAND entry at the l32r site, which (like R_XTENSA_SLOT0_OP)
// the parser correctly ignores: only R_XTENSA_32 entries are ever collected
// as patches.
//
// purr_win_create()-style calls still go through purr_kernel_ui() (a
// function-pointer struct behind ANOTHER named external symbol) — reaching
// those needs purr_kernel_ui() itself added to the import table, not a
// further loader change. Not needed for this selftest to prove the
// mechanism end-to-end.
//
// run3() (third test, below) exercises piece 2 — personal-space storage
// (claw_loader_personal_add/count/at/load/remove) — reusing guest3_o_bytes
// rather than compiling yet another guest object, since this test isn't
// about relocation/import behavior at all, just the SD file plumbing
// around an already-proven loadable object.
//
// run4() (fourth test, below) exercises piece 3 — the app_manager
// integration (APP_TIER_PERSONAL, app_manager_scan_ex()'s personal-app
// scan block, launch_personal()) — through app_manager's real PUBLIC API
// (app_manager_scan/count/get/launch_by_name/stop), not by calling
// claw_loader directly. This needed a NEW guest object: guest3's
// claw_personal_init() deliberately returns 109 to prove claw_loader_load()
// itself works, but native_task() (app_manager.c) treats any nonzero
// init() return as APP_STATE_ERROR — a personal app dispatched through the
// real launch path needs to actually report success (0) the way a real app
// would. guest5_o_bytes is a standalone compile of:
//
//   static int s_init_calls = 0;
//   int claw_personal_init(void) { s_init_calls++; return 0; }
//   void claw_personal_deinit(void) { s_init_calls = 0; }
//
// Compiled: xtensa-esp32s3-elf-gcc -mtext-section-literals -mlongcalls -O0 -c
//
// run4() also creates a throwaway user_mgr account ("selftest_user") to
// scan/launch under — since APP_TIER_PERSONAL apps are only ever scanned
// for the CURRENTLY LOGGED IN user (see app_manager_scan_ex()'s own
// comment) — and saves/restores whatever real session was active before
// the test, so it never leaves a real device logged out (or logged into a
// throwaway account) just from having run once.

#include <string.h>
#include "esp_log.h"
#include "freertos/FreeRTOS.h"
#include "freertos/task.h"
#include "claw_loader.h"
#include "user_mgr.h"
#include "app_manager.h"
#include "purr_kernel.h"   // purr_kernel_ui() — run5()'s own catcall_ui_t proof

static const char *TAG = "claw_loader_selftest";

static const uint8_t guest3_o_bytes[] = {
    0x7f, 0x45, 0x4c, 0x46, 0x01, 0x01, 0x01, 0x00, 0x00, 0x00, 0x00, 0x00,
    0x00, 0x00, 0x00, 0x00, 0x01, 0x00, 0x5e, 0x00, 0x01, 0x00, 0x00, 0x00,
    0x00, 0x00, 0x00, 0x00, 0x00, 0x00, 0x00, 0x00, 0xd4, 0x03, 0x00, 0x00,
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    0x00, 0x00, 0x00, 0x00, 0x01, 0x00, 0x00, 0x00, 0x00, 0x00, 0x00, 0x00,
};

// guest4_o_bytes — see this file's own header comment above for the source
// and the exact relocation this exercises (a R_XTENSA_32 against the
// UNDEFINED symbol "purr_kernel_uptime_ms").
static const uint8_t guest4_o_bytes[] = {
    0x7f, 0x45, 0x4c, 0x46, 0x01, 0x01, 0x01, 0x00, 0x00, 0x00, 0x00, 0x00,
    0x00, 0x00, 0x00, 0x00, 0x01, 0x00, 0x5e, 0x00, 0x01, 0x00, 0x00, 0x00,
    0x00, 0x00, 0x00, 0x00, 0x00, 0x00, 0x00, 0x00, 0x00, 0x04, 0x00, 0x00,
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    0x00, 0x00, 0x00, 0x00,
};

void claw_loader_selftest_run(void)
{
    claw_loaded_module_t m;
    if (!claw_loader_load(guest3_o_bytes, sizeof(guest3_o_bytes), &m)) {
        ESP_LOGE(TAG, "load failed");
        return;
    }

    int rc = m.init();
    ESP_LOGI(TAG, "claw_personal_init() = %d (expected 109)", rc);
    m.deinit();
    ESP_LOGI(TAG, "claw_personal_deinit() returned");

    ESP_LOGI(TAG, "%s", rc == 109 ? "SELFTEST PASS" : "SELFTEST FAIL");

    claw_loader_unload(&m);
}

// claw_loader_selftest_run2() — the import-table test. Same load/init/
// deinit/unload shape as claw_loader_selftest_run() above, but there's no
// fixed expected return value to compare against (unlike guest3's
// hand-computed 109): claw_personal_init() here returns a live millisecond
// uptime truncated to 31 bits, so this logs it and calls it a PASS if it
// came back nonzero and boot-plausible (a few thousand ms this late in
// boot, not zero/garbage) — eyeballed against the boot log, not asserted
// in code.
void claw_loader_selftest_run2(void)
{
    claw_loaded_module_t m;
    if (!claw_loader_load(guest4_o_bytes, sizeof(guest4_o_bytes), &m)) {
        ESP_LOGE(TAG, "run2: load failed");
        return;
    }

    int rc = m.init();
    ESP_LOGI(TAG, "run2: claw_personal_init() = %d (should be a plausible ms uptime, nonzero)", rc);
    m.deinit();
    ESP_LOGI(TAG, "run2: claw_personal_deinit() returned");

    ESP_LOGI(TAG, "run2: %s", rc > 0 ? "SELFTEST PASS (import table resolved purr_kernel_uptime_ms by name)" : "SELFTEST FAIL");

    claw_loader_unload(&m);
}

// claw_loader_selftest_run3() — piece 2: personal-space storage. Walks the
// whole lifecycle (add -> count -> at -> load -> init/deinit -> remove ->
// count again) under a throwaway username/appname, deleting what it wrote
// either way so a repeated run (or a real "selftest_user" someday) never
// finds stale state.
void claw_loader_selftest_run3(void)
{
    static const char *user = "selftest_user";
    static const char *app  = "selftest_app";

    bool added = claw_loader_personal_add(user, app, guest3_o_bytes, sizeof(guest3_o_bytes));
    ESP_LOGI(TAG, "run3: personal_add = %d", added);
    if (!added) { ESP_LOGE(TAG, "run3: SELFTEST FAIL (add)"); return; }

    int count = claw_loader_personal_count(user);
    ESP_LOGI(TAG, "run3: personal_count = %d (expected 1)", count);

    char name[48] = {0};
    bool got_at = claw_loader_personal_at(user, 0, name, sizeof(name));
    ESP_LOGI(TAG, "run3: personal_at(0) = '%s' (expected '%s', got=%d)", name, app, got_at);

    claw_loaded_module_t m;
    bool loaded = claw_loader_personal_load(user, app, &m);
    int rc = -1;
    if (loaded) {
        rc = m.init();
        ESP_LOGI(TAG, "run3: loaded claw_personal_init() = %d (expected 109)", rc);
        m.deinit();
        claw_loader_unload(&m);
    } else {
        ESP_LOGE(TAG, "run3: personal_load failed");
    }

    bool removed = claw_loader_personal_remove(user, app);
    int count2 = claw_loader_personal_count(user);
    ESP_LOGI(TAG, "run3: remove=%d, count after remove=%d (expected 0)", removed, count2);

    bool pass = added && (count == 1) && got_at && (strcmp(name, app) == 0) &&
                loaded && (rc == 109) && removed && (count2 == 0);
    ESP_LOGI(TAG, "run3: %s", pass ? "SELFTEST PASS" : "SELFTEST FAIL");
}

// guest5_o_bytes — see this file's own header comment above for the source
// and why it's a separate object from guest3's.
static const uint8_t guest5_o_bytes[] = {
    0x7f, 0x45, 0x4c, 0x46, 0x01, 0x01, 0x01, 0x00, 0x00, 0x00, 0x00, 0x00,
    0x00, 0x00, 0x00, 0x00, 0x01, 0x00, 0x5e, 0x00, 0x01, 0x00, 0x00, 0x00,
    0x00, 0x00, 0x00, 0x00, 0x00, 0x00, 0x00, 0x00, 0x6c, 0x03, 0x00, 0x00,
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    0x00, 0x00, 0x00, 0x00, 0x01, 0x00, 0x00, 0x00, 0x00, 0x00, 0x00, 0x00,
};

// guest_ui_o_bytes — piece 4: proof that a loaded .claw object can
// register a REAL catcall_ui_t and draw through it, not just call a named
// host function (guest4) or satisfy app_manager's launch contract
// (guest5). Standalone compile of a small object that:
//   - hand-declares its own copy of catcall_ui_t/catcall_display_t
//     (field-for-field matched against catcall_ui.h/catcall_display.h —
//     same "no #include access to real kernel headers" constraint guest4's
//     own comment already explains)
//   - builds its catcall_ui_t at RUNTIME inside claw_personal_init(), field
//     by field, rather than as a `static const` initializer — this is
//     LOAD-BEARING, not a style choice: claw_elf.c's relocator only walks
//     `.rela.text`, never `.rela.rodata`/`.rela.data`, so a compile-time
//     struct initializer's function-pointer fields would stay unpatched/
//     zero after loading. Confirmed by direct `objdump -r`/`readelf -S`
//     inspection before writing this comment — a `static const` version of
//     this exact struct compiled clean but would have loaded broken. This
//     is the single most important finding of this whole proof: the real
//     loginUI/systemUI-launcher packages MUST build their catcall_ui_t the
//     same runtime-assignment way, never as a static initializer.
//   - calls purr_kernel_register_ui() (now reachable via purr_kernel.h's
//     existing import-table entry, no generator change needed for this
//     specific call)
//   - then drives its own just-registered struct directly (win_create ->
//     win_show -> canvas_rect), since this self-test has no external app
//     to call purr_win_create()/trigger a real paint — canvas_rect calls
//     through to purr_kernel_display()->fill_rect() for real, so this
//     proves the FULL chain: loaded code's own vtable is genuinely
//     callable, and it reaches all the way to real pixels.
//
// Compiled: xtensa-esp32s3-elf-gcc -mtext-section-literals -mlongcalls -O0 -c
// .text=577 bytes, comfortably inside one 32KB claw_slot partition slot.
static const uint8_t guest_ui_o_bytes[] = {
    0x7f, 0x45, 0x4c, 0x46, 0x01, 0x01, 0x01, 0x00, 0x00, 0x00, 0x00, 0x00,
    0x00, 0x00, 0x00, 0x00, 0x01, 0x00, 0x5e, 0x00, 0x01, 0x00, 0x00, 0x00,
    0x00, 0x00, 0x00, 0x00, 0x00, 0x00, 0x00, 0x00, 0x0c, 0x0d, 0x00, 0x00,
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    0x01, 0x00, 0x00, 0x00, 0x00, 0x00, 0x00, 0x00,
};

// claw_loader_selftest_run4() — piece 3: the app_manager integration.
// Exercises the REAL public API (app_manager_scan/count/get/
// launch_by_name/stop), under a throwaway user_mgr account this creates
// and removes, restoring whatever real session was active beforehand.
void claw_loader_selftest_run4(void)
{
    static const char *user = "selftest_user";
    static const char *app  = "selftest_app4";

    char prev_user[USER_MGR_USERNAME_MAX + 1] = {0};
    bool was_logged_in = user_mgr_is_logged_in();
    if (was_logged_in) {
        strncpy(prev_user, user_mgr_current_user(), sizeof(prev_user) - 1);
    }
    ESP_LOGI(TAG, "run4: was_logged_in=%d prev_user='%s'", was_logged_in, prev_user);

    bool have_account = user_mgr_exists(user) || user_mgr_create(user, NULL);
    bool logged_in = have_account && user_mgr_set_logged_in(user);
    ESP_LOGI(TAG, "run4: have_account=%d logged_in=%d", have_account, logged_in);

    bool pass = false;
    if (logged_in) {
        bool added = claw_loader_personal_add(user, app, guest5_o_bytes, sizeof(guest5_o_bytes));
        ESP_LOGI(TAG, "run4: personal_add = %d", added);

        int found_count = app_manager_scan();
        ESP_LOGI(TAG, "run4: app_manager_scan() = %d apps total", found_count);

        int idx = -1;
        for (int i = 0; i < app_manager_count(); i++) {
            const app_entry_t *e = app_manager_get(i);
            if (e && strcmp(e->name, app) == 0) { idx = i; break; }
        }
        ESP_LOGI(TAG, "run4: found in registry at idx=%d", idx);

        if (idx >= 0) {
            const app_entry_t *e0 = app_manager_get(idx);
            ESP_LOGI(TAG, "run4: tier=%d (expect APP_TIER_PERSONAL=%d) path='%s'",
                     (int)e0->tier, (int)APP_TIER_PERSONAL, e0->path);

            int rc = app_manager_launch_by_name(app);
            // native_task() runs asynchronously on its own task — give it a
            // moment to actually call init() and report state, same as any
            // other async native app launch.
            vTaskDelay(pdMS_TO_TICKS(300));
            const app_entry_t *e1 = app_manager_get(idx);
            app_state_t st1 = e1 ? e1->state : APP_STATE_ERROR;
            ESP_LOGI(TAG, "run4: launch rc=%d, state after=%d (expect RUNNING=%d) error='%s'",
                     rc, (int)st1, (int)APP_STATE_RUNNING, e1 ? e1->error : "?");

            app_manager_stop(idx);
            const app_entry_t *e2 = app_manager_get(idx);
            app_state_t st2 = e2 ? e2->state : APP_STATE_ERROR;
            ESP_LOGI(TAG, "run4: state after stop=%d (expect STOPPED=%d)", (int)st2, (int)APP_STATE_STOPPED);

            pass = (e0->tier == APP_TIER_PERSONAL) && (rc == 0) &&
                   (st1 == APP_STATE_RUNNING) && (st2 == APP_STATE_STOPPED);
        }

        claw_loader_personal_remove(user, app);
    }

    // Clean up: remove the throwaway account (also logs it out per
    // user_mgr_remove()'s own contract), then restore whatever was logged
    // in before, if anything.
    user_mgr_remove(user);
    if (was_logged_in && prev_user[0]) {
        bool restored = user_mgr_set_logged_in(prev_user);
        ESP_LOGI(TAG, "run4: restored previous session '%s' = %d", prev_user, restored);
    }

    ESP_LOGI(TAG, "run4: %s", pass ? "SELFTEST PASS" : "SELFTEST FAIL");
}

// claw_loader_selftest_run5() — piece 4: the catcall_ui_t proof (see
// guest_ui_o_bytes's own comment for the full picture, including the
// most important finding: a loaded object's catcall_ui_t MUST be built
// via runtime field assignment, never a static initializer, or
// claw_elf.c's .rela.text-only relocator leaves its function pointers
// unpatched). Confirms purr_kernel_ui() actually becomes non-NULL after
// loading and that the drawn rect is real — eyeballed on the physical
// display, not asserted in code (there's no framebuffer readback catcall
// to assert against).
void claw_loader_selftest_run5(void)
{
    const catcall_ui_t *before = purr_kernel_ui();
    ESP_LOGI(TAG, "run5: purr_kernel_ui() before load = %p (expect NULL or a previously registered backend)", (void *)before);

    claw_loaded_module_t m;
    if (!claw_loader_load(guest_ui_o_bytes, sizeof(guest_ui_o_bytes), &m)) {
        ESP_LOGE(TAG, "run5: load failed");
        return;
    }

    // Root cause found and fixed in claw_elf.c (see that file's own
    // comment on the local-section relocation branch): this toolchain
    // embeds a local relocation's real target offset as pre-existing bytes
    // at the relocation site itself, not in r_addend (which is always 0).
    // The loader used to trust r_addend alone — silently correct for every
    // offset-0 target (which is all guest3/4/5 and this object's OWN
    // win_create field ever exercised), silently WRONG for anything at a
    // nonzero offset (s_registered, at .bss+0xb0, corrupting s_ui.name at
    // .bss+0 the moment `s_registered = 1;` ran — confirmed via direct
    // objdump -d/readelf -r before the fix, not guessed).
    int rc = m.init();
    const catcall_ui_t *after = purr_kernel_ui();
    ESP_LOGI(TAG, "run5: claw_personal_init() = %d (expect 0), purr_kernel_ui() after = %p (name='%s')",
             rc, (void *)after, (after && after->name) ? after->name : "?");

    bool pass = (rc == 0) && after && after->name && strcmp(after->name, "guest_ui") == 0;
    ESP_LOGI(TAG, "run5: %s — check the physical display for a white ~60x60 square near (10,10)",
             pass ? "SELFTEST PASS (registration + call chain + real drawing)" : "SELFTEST FAIL");

    m.deinit();
    purr_kernel_unregister_ui(after);   // matched — see purr_kernel.h's own "last registered wins" doc comment
    claw_loader_unload(&m);
}
