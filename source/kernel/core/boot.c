// boot.c — PURR OS kernel boot entry
//
// Boot sequence:
//   1. NVS init
//   2. Mount flash VFS at /flash  (SPIFFS partition — contains core .purr blobs)
//   3. Mount SD VFS at /sdcard    (FAT — optional, used as fallback + user content)
//   4. Scan /flash/modules + /flash/drivers in priority order (P1→P2→P3)
//      — P1 (REQUIRED): panic if missing from both flash and SD
//      — P2 (IMPORTANT): warn if missing, continue
//      — P3 (OPTIONAL): silent skip
//   5. Scan /sdcard/modules + /sdcard/drivers for extras not on flash
//   6. Kernel spine parks in idle loop — everything else runs in module tasks

#include "purr_kernel.h"
#include "purr_crash_guard.h"
#include "esp_log.h"
#include "esp_spiffs.h"
#include "esp_vfs_fat.h"
#include "driver/sdspi_host.h"
#include "sdmmc_cmd.h"
#include "nvs_flash.h"
#include "freertos/FreeRTOS.h"
#include "freertos/task.h"
#include <string.h>
#include <sys/stat.h>

static const char *TAG = "purr_boot";

// ── Flash VFS (SPIFFS) ────────────────────────────────────────────────────────

static void mount_flash_vfs(void)
{
    esp_vfs_spiffs_conf_t conf = {
        .base_path              = "/flash",
        .partition_label        = NULL,   // uses first SPIFFS partition in table
        .max_files              = 12,
        .format_if_mount_failed = false,
    };
    esp_err_t ret = esp_vfs_spiffs_register(&conf);
    if (ret != ESP_OK) {
        ESP_LOGW(TAG, "SPIFFS mount failed (%s) — no flash VFS", esp_err_to_name(ret));
    } else {
        size_t total = 0, used = 0;
        esp_spiffs_info(NULL, &total, &used);
        ESP_LOGI(TAG, "flash VFS: %u KB used / %u KB total",
                 (unsigned)(used / 1024), (unsigned)(total / 1024));
    }
}

// ── SD card VFS (FAT) ────────────────────────────────────────────────────────
//
// SD is always optional. If not present (no card, no SPI config), boot continues
// without it. The SD SPI bus/pins are configured at build time from device.pcat.
// If SD mounts, the kernel sets purr_kernel_set_sd_available(true) so modules
// can check before trying to open /sdcard paths.

static void mount_sd_vfs(void)
{
    // The SD driver module (drv_sd) handles hardware init and mounts the
    // FAT filesystem via esp_vfs_fat_sdspi_mount. When it succeeds it calls
    // purr_kernel_set_sd_available(true).
    //
    // boot.c doesn't touch SPI or pins directly — that's a driver concern.
    // We just note whether /sdcard is usable after modules load.
    ESP_LOGI(TAG, "SD mount delegated to drv_sd module");
}

// ── Ensure standard SD directory layout ──────────────────────────────────────

static void ensure_sd_dirs(void)
{
    // Only attempt if SD is mounted
    if (!purr_kernel_sd_available()) return;

    const char *dirs[] = {
        "/sdcard/apps",           // user apps (.meow, .hiss, .paws, .claw)
        "/sdcard/modules",        // kernel module fallbacks (.purr)
        "/sdcard/drivers",        // driver fallbacks (.purr, flat or typed)
        "/sdcard/drivers/display",
        "/sdcard/drivers/touch",
        "/sdcard/drivers/input",
        "/sdcard/drivers/radio",
        "/sdcard/drivers/gps",
        "/sdcard/magicmac",       // MagicMac ROM + config
        "/sdcard/magidos",        // MagiDOS disk images + config
        "/sdcard/system",         // system files
        "/sdcard/system/logs",    // kernel + module logs
        NULL
    };

    for (int i = 0; dirs[i]; i++) {
        struct stat st;
        if (stat(dirs[i], &st) != 0) {
            mkdir(dirs[i], 0755);
        }
    }
}

// ── app_main ──────────────────────────────────────────────────────────────────

void app_main(void)
{
    ESP_LOGI(TAG, "PURR OS %s / KITT %s  booting...", PURR_KERNEL_VERSION, KITT_VERSION);

    // NVS for WiFi + settings persistence
    esp_err_t nvs_ret = nvs_flash_init();
    if (nvs_ret == ESP_ERR_NVS_NO_FREE_PAGES || nvs_ret == ESP_ERR_NVS_NEW_VERSION_FOUND) {
        nvs_flash_erase();
        nvs_flash_init();
    }

    mount_flash_vfs();
    mount_sd_vfs();
    ensure_sd_dirs();

    // ── Phase 1: load all built-in modules ───────────────────────────────────
    //
    // purr_register_static_modules() is generated by purrstrap from device.pcat
    // and lives in purr_device_glue.c. It calls purr_kernel_register_module_static()
    // for every driver and system module the device needs.
    // purr_kernel_load_static_modules() then sorts by priority and calls init().
    // P1 modules that fail to init trigger purr_kernel_panic().
    ESP_LOGI(TAG, "=== phase 1: static modules ===");
    // Device-specific early setup (e.g. a board power rail that must be
    // enabled before its peripheral drivers can talk to anything) — must
    // run before module init below. Generated by purrstrap from
    // device.pcat; empty body for devices that don't need one. This was
    // previously generated but never actually called anywhere — confirmed
    // live as the root cause of a Heltec V3's OLED silently never lighting
    // up: its I2C writes "succeeded" against an unpowered, floating bus
    // (Vext, GPIO36, must be driven low first) with no error surfaced.
    extern void purr_device_init(void);
    purr_device_init();

    // Must run before purr_kernel_load_static_modules() — "before anything
    // reads a strike count this boot" (purr_crash_guard.c's own comment).
    // load_one_static() checks purr_crash_guard_is_disabled() per module as
    // part of that call, so any device using this generic kernel never got
    // its ELF-hash-keyed strike reset at all: this call previously existed
    // only in the specialized T-Deck Plus kernels (kernel_tdp_boot.c) and
    // the unused Tab5 legacy kernel — never here. Confirmed live: a Tab5
    // running the generic kernel hit a real app_manager_scan_ex() null-deref
    // (unrelated bug, s_apps used before app_manager_init() allocates it),
    // crash-guard correctly disabled app_manager after repeated strikes,
    // and NO subsequent reflash — even a completely different firmware
    // build — ever cleared that disabled state, because nothing here ever
    // called the function that's supposed to. Same shape of gap as
    // purr_kernel_set_boot_ready() below.
    purr_crash_guard_check_reset_reason();

    // Captured now, before load_static_modules — that call reads the
    // pending-recovery flag itself (purr_kernel.c's load path) to bound each
    // P2/P3 module's init this boot, and we need the same value afterwards to
    // decide whether to end the recovering window.
    bool recovering = purr_crash_guard_pending_recovery(NULL, 0, NULL, 0);

    extern void purr_register_static_modules(void);
    purr_register_static_modules();
    purr_kernel_load_static_modules();

    // End the "recovering" window — every P2/P3 module has now had its one
    // bounded bring-up attempt for this boot. THIRD generic-kernel gap of the
    // same shape as the two above (crash-guard reset, boot_ready): the call
    // that clears this flag existed only in the specialized T-Deck Plus kernel
    // (kernel_tdp_boot.c), never here. Without it the flag, once written by a
    // single hang-triggered reboot, is NEVER cleared on a generic-kernel
    // device — so EVERY subsequent boot is perpetually treated as a recovery
    // boot and bounds P2/P3 init to 5s. Confirmed live on Tab5: app_manager's
    // init ran on run_bounded's helper task under that 5s cap on every boot,
    // "timed out" (it did not actually — the helper simply hadn't finished
    // within the cap), took a strike each boot, and marched toward the disable
    // threshold with no crash needed. Must run AFTER load_static_modules (it
    // needs the flag still set during Phase 1), matching the T-Deck kernel.
    if (recovering) {
        purr_crash_guard_clear_pending_recovery();
    }

    // ── Phase 2: SD extras (optional modules not compiled in) ─────────────────
    //
    // User-supplied .purr blobs on SD card. Always treated as OPTIONAL
    // regardless of their header priority — third-party or user-added modules.
    if (purr_kernel_sd_available()) {
        ESP_LOGI(TAG, "=== phase 2: SD extras ===");
        purr_kernel_scan_modules("/sdcard/modules", NULL);
        purr_kernel_scan_modules("/sdcard/drivers", NULL);
    }

    // Sanity checks — warn if critical modules never registered catcalls
    if (!purr_kernel_display()) {
        ESP_LOGW(TAG, "no display catcall registered after module load");
    }
    if (!purr_kernel_get_module("app_manager")) {
        ESP_LOGW(TAG, "app_manager not loaded — no apps will run");
    }

    // Boot-ready gate. The specialized T-Deck kernels set this at the end of
    // their boot (kernel_tdp_boot.c:546) and LVGL-family UI tasks (cupcake's
    // cupcake_task, cardstack's) spin on purr_kernel_boot_ready() before
    // building their home screens — but this generic boot never set it, so
    // any of those UIs on a native-kernel device waited forever with a blank
    // panel and zero log output (confirmed live: cupcake on tab5). MiniWin
    // doesn't check it, which is why every native MiniWin device masked this.
    purr_kernel_set_boot_ready(true);

    ESP_LOGI(TAG, "boot complete — %u bytes free", (unsigned)purr_kernel_free_ram());

    // Kernel spine parks here. All work happens in module FreeRTOS tasks.
    // The active UI module opens the Cat Apps launcher after its WM is ready.
    while (1) {
        vTaskDelay(pdMS_TO_TICKS(10000));
    }
}
